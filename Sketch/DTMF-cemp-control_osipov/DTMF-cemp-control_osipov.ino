
#include <TMRpcm.h>   // добавление библиотек
#include <SPI.h>

TMRpcm wav;               // инициализация TMRpcm и присвоение переменной wav

#include <SD.h>             
#define SD_ChipSelectPin 4  // контакт CS шилда сд-карты на 4 пине ардуино уно

int x = 0;

// Массив для аудио файлов "wav". На SD карте удалил из имени файла, названия-расширения-.wav.
char* AudioDigits[]={
 "0","1","2","3","4","5","6","7","8","9","10","11","12","13","14","15","16","17","18","19","20","21","22","23","23","25","26","27","28","29","30"
 ,"31","32","33","34","35","36","37","38","39","40","41","42","43","44","45","46","47","48","49","50","51","52","53","54","55","56","57","58","59"
 ,"60","61","62","63","64","65","66","67","68","69","70","71","72","73","74","75","76","77","78","79","80","81","82","83","83","85","86","87","88"
 ,"89","90","91","92","93","94","95","96","97","98","99","100" };

void setup(){
  
  Serial.begin(115200);
  wav.speakerPin = 9;        //5,6,11,46 для Mega, 9 для Uno, Nano.
  //Complimentary Output or Dual Speakers:
  //pinMode(10,OUTPUT); Pin pairs: 9,10.  Mega: 5-2,6-7,11-12,46-45 
  
  if (!SD.begin(SD_ChipSelectPin)) { 
    Serial.println("SD fail");  
    return;
  }else{   Serial.println("SD ok"); }


wav.play("syspower");        //звуковой файл "syspower" будет воспроизводиться при включении ардуино или её перезагрузке
}


void loop(){
  
  if(Serial.available()){  
    switch(Serial.read()){
    case 'd': wav.play(AudioDigits[x]); x++; break;    
    case 'P':  break;
    case 't':  break;
    }
  }
  
}
